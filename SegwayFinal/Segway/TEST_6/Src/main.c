/**
  ******************************************************************************
  * File Name          : main.c
  * Description        : Main program body
  ******************************************************************************
  *
  * COPYRIGHT(c) 2016 STMicroelectronics
  *
  * Redistribution and use in source and binary forms, with or without modification,
  * are permitted provided that the following conditions are met:
  *   1. Redistributions of source code must retain the above copyright notice,
  *      this list of conditions and the following disclaimer.
  *   2. Redistributions in binary form must reproduce the above copyright notice,
  *      this list of conditions and the following disclaimer in the documentation
  *      and/or other materials provided with the distribution.
  *   3. Neither the name of STMicroelectronics nor the names of its contributors
  *      may be used to endorse or promote products derived from this software
  *      without specific prior written permission.
  *
  * THIS SOFTWARE IS PROVIDED BY THE COPYRIGHT HOLDERS AND CONTRIBUTORS "AS IS"
  * AND ANY EXPRESS OR IMPLIED WARRANTIES, INCLUDING, BUT NOT LIMITED TO, THE
  * IMPLIED WARRANTIES OF MERCHANTABILITY AND FITNESS FOR A PARTICULAR PURPOSE ARE
  * DISCLAIMED. IN NO EVENT SHALL THE COPYRIGHT HOLDER OR CONTRIBUTORS BE LIABLE
  * FOR ANY DIRECT, INDIRECT, INCIDENTAL, SPECIAL, EXEMPLARY, OR CONSEQUENTIAL
  * DAMAGES (INCLUDING, BUT NOT LIMITED TO, PROCUREMENT OF SUBSTITUTE GOODS OR
  * SERVICES; LOSS OF USE, DATA, OR PROFITS; OR BUSINESS INTERRUPTION) HOWEVER
  * CAUSED AND ON ANY THEORY OF LIABILITY, WHETHER IN CONTRACT, STRICT LIABILITY,
  * OR TORT (INCLUDING NEGLIGENCE OR OTHERWISE) ARISING IN ANY WAY OUT OF THE USE
  * OF THIS SOFTWARE, EVEN IF ADVISED OF THE POSSIBILITY OF SUCH DAMAGE.
  *
  ******************************************************************************
  */
/* Includes ------------------------------------------------------------------*/
#include "stm32f1xx_hal.h"
#include "adc.h"
#include "dma.h"
#include "spi.h"
#include "tim.h"
#include "usart.h"
#include "gpio.h"

/* USER CODE BEGIN Includes */
int32_t NO_OF;

uint16_t const SVM_TABLE[4800]={
	2078,2080,2081,2083,2084,2086,2087,2089,2090,2092,
	2093,2095,2097,2098,2100,2101,2103,2104,2106,2107,2109,2110,2112,2113,
	2115,2116,2118,2119,2121,2122,2123,2125,2126,2128,2129,2131,2132,
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	2097,2095,2093,2092,2090,2089,2087,2086,2084,2083,2081,2080,
	};



int16_t const COSINE_TABLE[4800]={
2047,2047,2047,2047,2047,2047,2047,2047,2047,2047,
	2047,2047,2047,2047,2047,2047,2047,2047,2047,2047,2047,2047,2047,
	2047,2046,2046,2046,2046,2046,2046,2046,2046,2046,2046,2045,2045,2045,
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	2047,2047,2047,
	};



int16_t const INV_TAN[4096]={
-600,-600,-600,-600,-600,-600,-599,-599,-599,-599,
	-599,-598,-598,-598,-598,-598,-598,-597,-597,-597,-597,-597,-596,-596,
	-596,-596,-596,-595,-595,-595,-595,-595,-594,-594,-594,-594,-594,
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	597,597,598,598,598,598,598,599,599,599,599,599,
	};



int16_t const RADICAL[4096]={
0,64,90,110,128,143,156,169,181,192,202,212,
	221,230,239,247,256,263,271,278,286,293,300,306,313,320,326,332,338,
	344,350,356,362,367,373,378,384,389,394,399,404,409,414,419,424,429,
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	4090,4090,4091,4091,4092,4092,4093,4093,4094,4094,4095,
	};
/* USER CODE END Includes */

/* Private variables ---------------------------------------------------------*/
uint8_t LastSpiData = 0,SpiSeq = 0,MyAddress = 0x49,DataToRecieveLength=0;
uint8_t DataRX[20];
uint8_t NewDataFlag = 0;
uint32_t CommandRecieveCount = 0;
uint32_t DataLostCount = 0;
uint8_t  SpiRXData;
int16_t  InputSpeed = 0;
#define print(x) HAL_UART_Transmit(&huart1,(uint8_t *)x,strlen(x),100);
/* USER CODE BEGIN PV */
/* Private variables ---------------------------------------------------------*/



//ADC(CURRENT INPUT) :
	uint16_t ADC_DATA[3],ADC_FLT[3][8],FLT_CNT=0,I[3];//ADC raw and filtered data. these data contain 3 current sensors outputs.


//CURRENT_FEEDBACK :
	int32_t PHI_dq,Id,Iq;
	int32_t Ia,Ib,I1,I2,I3;//Alpha and Beta Currents and 3 sensors currents.
	int32_t I10=1638,I20=1638,I30=1638;//current sensors zero offset.these values represent the zero current.

//FREE_RUNNING :
	int32_t ACC=0,SPD=0,POS=0;//Acceleration,Speed,Position and current amplitude References.

//POLAR_CURRENT :
	int32_t PHI_IN,AMP_IN,AMP_OUT,PHI_OUT,ratio;//Phase and Amplitude of input current and output voltage.

//ANGLE_ESTIMATION :
	int32_t PHI_READ,T_MAX,DPHI,SPD_READ,ACC_READ,TIM2_OF,DELTA;

//HALL_SENSORS :
	int32_t const HALL_STATE[8]={6,3,1,2,5,4,0,6};
	int32_t const HALL_ANGLE[7]={4430,489,1224,2102,2812,3662,0};
//	int32_t const HALL_ANGLE[7]={4400,400,1200,2000,2800,3600,0};
	//1_3_2_6_4_5
	//2_3_1_5_4_6

//CONTROLLER :
	int32_t D_Id,D_Iq,I_Id,I_Iq,E_Id,E_Iq,R_Id,R_Iq;//Derivation,Integration,Error and Reference value of Alpha and Beta Currents.
	int32_t CTRL_d,CTRL_q,KP,KD,KI,INT_MAX;//Alpha-Beta Current control method PID Coefficients, controllers output and integrator maximum value.
	int32_t KFF,PI_Ratio;//Feed Forward Coefficient, KP to KI Ratio
	int32_t Ved,Veq,Ve_AMP,Ve_PHI;//Electromotive voltage (d,q),
	int32_t KMIX,Ve0,Ve1,K_RATE,KMIX_FLT[100];
//DEBUGING :
	int32_t EXTI_FLAG=0;

	int32_t DEBUG_1,DEBUG_2,DEBUG_3;

//Protection
	int32_t FAULT_CNT=0;//number of Faults


/* USER CODE END PV */

/* Private function prototypes -----------------------------------------------*/
void SystemClock_Config(void);

/* USER CODE BEGIN PFP */
/* Private function prototypes -----------------------------------------------*/

	void ADC_FILTER()//Single Pole Digital Filter on ADC inputs
	{
		int i,j;
		for(j=0;j<3;j++){
			ADC_FLT[j][FLT_CNT]=ADC_DATA[j];
			I[j]=0;
			for(i=0;i<8;i++){
				I[j]+=ADC_FLT[j][i];
			}
			I[j]=I[j]>>3;
		}
		FLT_CNT++;
		if (FLT_CNT>=8)FLT_CNT=0;
	}

	void ab_CONV(int32_t *Ix,int32_t  *Iy)
	{
		I1=I[0]-1850;
		I2=I[1]-1850;
		I3=I[2]-1850;
		*Ix=(((I1-((I2+I3)>>1))*2730)>>12);
		*Iy=((I3-I2)*2364)>>12;
	}

	void dq_CONV(int32_t Ix,int32_t  Iy,int32_t PHI,int32_t *_Id,int32_t  *_Iq)
	{
		*_Id=Ix*COSINE_TABLE[PHI]>>11;
		*_Iq=Iy*COSINE_TABLE[PHI]>>11;
		PHI=1200-PHI;
		if(PHI<0)PHI+=4800;
		*_Id+=Iy*COSINE_TABLE[PHI]>>11;
		*_Iq-=Ix*COSINE_TABLE[PHI]>>11;
	}

	void POLAR_CONV(int32_t Ix,int32_t  Iy,int32_t *PHASE,int32_t *AMPLITUDE)
	{

		*AMPLITUDE=(Ix*Ix+Iy*Iy)>>10;
		if (*AMPLITUDE>=4096)*AMPLITUDE=4095;
		*AMPLITUDE=RADICAL[*AMPLITUDE];

		if (Ix>Iy)
		{
			if (Iy>-Ix)
			{
				ratio=((Iy<<11)/Ix)+2048;
				if (ratio>=4096)ratio=4095;
				if (ratio<0)ratio=0;
				*PHASE=INV_TAN[ratio];
			}else{
				ratio=((Ix<<11)/Iy)+2048;
				if (ratio>=4096)ratio=4095;
				if (ratio<0)ratio=0;
				*PHASE=-INV_TAN[ratio]+3600;
			}
		}else{
			if (Iy>-Ix)
			{
				ratio=2048-((Ix<<11)/Iy);
				if (ratio>=4096)ratio=4095;
				if (ratio<0)ratio=0;
				*PHASE=INV_TAN[ratio]+1200;
			}else{
				ratio=2048-((Iy<<11)/Ix);
				if (ratio>=4096)ratio=4095;
				if (ratio<0)ratio=0;
				*PHASE=-INV_TAN[ratio]+2400;
			}
		}
		if (*PHASE<0)*PHASE+=4800;
		if (*PHASE>=4800)*PHASE-=4800;
	}

	void SPWM(int32_t _PHASE,int32_t _AMPLITUDE)
	{
		if (_PHASE<0)_PHASE+=4800;
		if (_PHASE>=4800)_PHASE-=4800;
		TIM1->CCR1=((COSINE_TABLE[_PHASE]*_AMPLITUDE)>>12)+2048;

		_PHASE+=1600;
		if (_PHASE>=4800)_PHASE-=4800;
		TIM1->CCR2=((COSINE_TABLE[_PHASE]*_AMPLITUDE)>>12)+2048;

		_PHASE+=1600;
		if (_PHASE>=4800)_PHASE-=4800;
		TIM1->CCR3=((COSINE_TABLE[_PHASE]*_AMPLITUDE)>>12)+2048;
	}

	void SVM(int32_t _PHASE,int32_t _AMPLITUDE)
	{
		if (_PHASE<0)_PHASE+=4800;
		if (_PHASE>=4800)_PHASE-=4800;
		TIM1->CCR1=(SVM_TABLE[_PHASE]*_AMPLITUDE)>>13;

		_PHASE+=1600;
		if (_PHASE>=4800)_PHASE-=4800;
		TIM1->CCR2=(SVM_TABLE[_PHASE]*_AMPLITUDE)>>13;

		_PHASE+=1600;
		if (_PHASE>=4800)_PHASE-=4800;
		TIM1->CCR3=(SVM_TABLE[_PHASE]*_AMPLITUDE)>>13;
	}

	void PID_CTRL()
	{
	int32_t	t1,t2;
		t1=E_Id; //Last Error
		t2=E_Iq;
		E_Id=R_Id-Id; // New Error
		E_Iq=R_Iq-Iq;
		I_Id+=E_Id; // Error SUM
		I_Iq+=E_Iq;
		if (I_Id>=INT_MAX)I_Id=INT_MAX; // Clamp Integrated Error by +INT_MAX and -INT_MAX
		if (I_Id<-INT_MAX)I_Id=-INT_MAX;
		if (I_Iq>=INT_MAX)I_Iq=INT_MAX;
		if (I_Iq<-INT_MAX)I_Iq=-INT_MAX;
		D_Id=(((E_Id-t1)*1)+D_Id)>>1; // Single Pole Filtered Error Difference
		D_Iq=(((E_Iq-t2)*1)+D_Iq)>>1;
		CTRL_d=((E_Id*KP)>>12)+((I_Id*KI)>>12)+((D_Id*KD)>>12); // PID Controllers MIX
		if (CTRL_d>=2048)CTRL_d=2047; // Clamp Controller Output
		if (CTRL_d<-2048)CTRL_d=-2047;
		CTRL_q=((E_Iq*KP)>>12)+((I_Iq*KI)>>12)+((D_Iq*KD)>>12);
		if (CTRL_q>=2048)CTRL_q=2047;
		if (CTRL_q<=-2048)CTRL_q=-2047;
	}

	void CHC_CTRL()
	{
	int16_t	temp=0;
		if (Id>R_Id+20)temp=(R_Id>>1)-(AMP_IN>>2);
		if (Id<R_Id-20)temp=(R_Id>>1)+(AMP_IN>>2);
		CTRL_d=(CTRL_d*1+temp)>>1;
		if (CTRL_d>=2048)CTRL_d=2047;
		if (CTRL_d<-2048)CTRL_d=-2048;

		if (Iq>R_Iq+20)temp=(R_Iq>>1)-(AMP_IN>>2);
		if (Iq<R_Iq-20)temp=(R_Iq>>1)+(AMP_IN>>2);
		CTRL_q=(CTRL_q*1+temp)>>1;
		if (CTRL_q>=2048)CTRL_q=2047;
		if (CTRL_q<=-2048)CTRL_q=-2047;
	}

	void SPD_ESTIMATION()
	{
		DPHI=PHI_READ;
		PHI_READ=HALL_ANGLE[HALL_STATE[GPIOA->IDR&7]];
		DPHI=PHI_READ-DPHI;
		if (DPHI>2400)DPHI=4800-DPHI;
		if (DPHI<-2400)DPHI=4800+DPHI;
		ACC_READ=SPD_READ;
		SPD_READ=(DPHI*8000000)/T_MAX;
		ACC_READ=(ACC_READ-SPD_READ)*8/T_MAX;
	}

	void HAL_GPIO_EXTI_Callback(uint16_t GPIO_Pin)
	{
		EXTI_FLAG++;
		if ((TIM2->CNT>200)||(TIM2_OF)){
			T_MAX=TIM2->CNT;
			if (TIM2_OF)T_MAX=65535;
			TIM2_OF=0;
			SPD_ESTIMATION();
			TIM2->CNT=0;
		}
		EXTI_FLAG--;
	}

	void STATE_OBSERVER()
	{
		int32_t KMIX_nf;
		Ved=((Id*2867)>>12)-CTRL_d;
		Veq=((Iq*2867)>>12)-CTRL_q;
		POLAR_CONV(Ved,Veq,&Ve_PHI,&Ve_AMP);
		Ve_PHI+=PHI_dq+1200;
		while (Ve_PHI>=4800)Ve_PHI-=4800;
		if (Ve_AMP>Ve1)
		{
			KMIX_nf=4096;
		}else if (Ve_AMP>Ve0)
		{
			KMIX_nf=((Ve_AMP-Ve0)*K_RATE);
		}else{
			KMIX_nf=0;
		}
		KMIX=(KMIX*127+KMIX_nf)>>7;
		KMIX=4096;
	}

	void POSITION_ESTIMATOR()
	{
		if (((PHI_IN-Ve_PHI)<2400)&&((PHI_IN-Ve_PHI)>=-2400)){
			DEBUG_1=((PHI_IN*(4096-KMIX))+(Ve_PHI*KMIX))>>12;
		}else{
			if (PHI_IN<=2400){
				DEBUG_1=(((PHI_IN+4800)*(4096-KMIX))+(Ve_PHI*KMIX))>>12;
			}else{
				DEBUG_1=(((PHI_IN)*(4096-KMIX))+((Ve_PHI+4800)*KMIX))>>12;
			}
		}
		if (DEBUG_1>=4800)DEBUG_1-=4800;
		if (DEBUG_1<0)DEBUG_1+=4800;

		if (((DEBUG_2-DEBUG_1)<2400)&&((DEBUG_2-DEBUG_1)>=-2400)){
			DEBUG_2=(DEBUG_2*1023+DEBUG_1)>>10;
		}else{
			if (DEBUG_2<=2400){
				DEBUG_2=((DEBUG_2+4800)*1023+DEBUG_1)>>10;
			}else{
				DEBUG_2=(DEBUG_2*1023+(DEBUG_1+4800))>>10;
			}
		}
	}

	void SPEED_ESTIMATOR()
	{

	}

	void HAL_TIM_PeriodElapsedCallback(TIM_HandleTypeDef *htim)
	{
		if (htim==&htim4)
		{
			HAL_GPIO_WritePin(GPIOB,GPIO_PIN_1,0);
			HAL_GPIO_WritePin(GPIOB,GPIO_PIN_0,0);
			POS+=SPD;
			SPD+=ACC;
			if(SPD>=100000000)SPD=100000000;
			if(SPD<=-100000000)SPD=-100000000;
			while(POS>=10000000){
				POS-=10000000;
				PHI_IN++;
			}
			while(POS<=-10000000){
				POS+=10000000;
				PHI_IN--;
			}
			if(PHI_IN<0)PHI_IN+=4800;
			if(PHI_IN>=4800)PHI_IN-=4800;
			if (EXTI_FLAG!=0)
			{
				HAL_GPIO_WritePin(GPIOB,GPIO_PIN_1,0);
				SPD_ESTIMATION();
				EXTI_FLAG=0;
			}
			if (DPHI==0)
			{
				//FATAL ERROR
			}
			R_Id=0;
			R_Iq=AMP_IN;
			PHI_dq=PHI_IN;//Use this Line without Position Estimation
			POSITION_ESTIMATOR();
//			PHI_dq=DEBUG_1;
			ADC_FILTER();
			ab_CONV(&Ia,&Ib);
			dq_CONV(Ia,Ib,PHI_dq,&Id,&Iq);
			PID_CTRL();
//			CHC_CTRL();
			STATE_OBSERVER();
			POLAR_CONV(CTRL_d,CTRL_q,&PHI_OUT,&AMP_OUT);
//			POLAR_CONV(R_Id/3,R_Iq/3,&PHI_OUT,&AMP_OUT);
			PHI_OUT+=PHI_dq;
			if (PHI_OUT>=4800)PHI_OUT-=4800;
			DELTA=PHI_OUT-PHI_IN-1200;
			if (DELTA>=2400)DELTA-=4800;
			if (DELTA<-2400)DELTA+=4800;
			SPWM(PHI_OUT,AMP_OUT);
//			SVM(PHI_OUT,AMP_OUT);
			TIM3->CCR3=(Ve_AMP*256/4800);
			TIM3->CCR4=(DEBUG_1*256/4800);
			//current=26.8*(Vout-1.7)
//			if(HAL_GPIO_ReadPin(GPIOA,GPIO_PIN_0)==0)
//				HAL_GPIO_WritePin(GPIOB,GPIO_PIN_1,0);
//			else HAL_GPIO_WritePin(GPIOB,GPIO_PIN_1,1);
			//Hamed Codes {HJ}
			 if(NewDataFlag == 1 )
			 {
				  NewDataFlag = 0;
				  ProcessData();
			 }
			 //TODO : Uncomment next while for real test {HJ}
//			while(!(TIM1->BDTR&0x8000))
//			{
//				FAULT_CNT++;
//				HAL_Delay(50*FAULT_CNT*FAULT_CNT+100);
//				if (FAULT_CNT<5)TIM1->BDTR|=0x8000;
//			}
			HAL_GPIO_WritePin(GPIOB,GPIO_PIN_1,1);
			HAL_GPIO_WritePin(GPIOB,GPIO_PIN_0,1);

		}
		if (htim==&htim2)
		{
			TIM2_OF=1;
		}
	}

	void ZERO_INIT(void)
	{
		//CONTROLLER_PARAMETERS:
		PI_Ratio=30;
		KI=250;
		KP=PI_Ratio*KI;
		KD=20000;
		INT_MAX=(2048*4096)/KI;
		KMIX=0;
		Ve0=100;
		Ve1=1000;
		K_RATE=(4096/(Ve1-Ve0));
		PHI_dq=PHI_IN;
		//

		//FREE_RUNNING_PARAMETERS:
		AMP_IN=800;
		ACC=1000;
		SPD=10000000;
		//

		//CURRENT_SENSORS_OFFSET:
		I10=1860;
		I20=1860;
		I30=1860;
		//

		//ADC_INITIALIZE:
		HAL_ADCEx_Calibration_Start(&hadc1);//ADC calibration
		HAL_Delay(1000);//Waiting for Confidence.
		HAL_ADC_Start_DMA(&hadc1,(uint32_t *)ADC_DATA,3);//ADC START.
		//

		//TIMERS_INITIALIZE:
		TIM1->ARR=4096;//PWM GENERATOR TIMER : 17.578125 KHz
		TIM4->ARR=4800;//CONTROLL SYSTEM TIMER : 15 KHz
		TIM3->ARR=256;//DAC TIMER : 150KHz
		TIM2->ARR=601;//HALL Sensore Timer
		SVM(0,0);
		HAL_TIM_PWM_Start(&htim1,TIM_CHANNEL_1);
		HAL_TIM_PWM_Start(&htim1,TIM_CHANNEL_2);
		HAL_TIM_PWM_Start(&htim1,TIM_CHANNEL_3);
		HAL_TIMEx_PWMN_Start(&htim1,TIM_CHANNEL_1);
		HAL_TIMEx_PWMN_Start(&htim1,TIM_CHANNEL_2);
		HAL_TIMEx_PWMN_Start(&htim1,TIM_CHANNEL_3);

		HAL_TIM_PWM_Start(&htim3,TIM_CHANNEL_3);
		HAL_TIM_PWM_Start(&htim3,TIM_CHANNEL_4);

		HAL_GPIO_WritePin(GPIOA,GPIO_PIN_8|GPIO_PIN_9|GPIO_PIN_10,1);
		HAL_GPIO_WritePin(GPIOB,GPIO_PIN_13|GPIO_PIN_14|GPIO_PIN_15,1);

		HAL_TIM_Base_Start_IT(&htim4);
		HAL_TIM_Base_Start_IT(&htim2);
		//

		//INITIALIZATION_END:
		HAL_GPIO_WritePin(GPIOB,GPIO_PIN_1,1);
		HAL_GPIO_WritePin(GPIOB,GPIO_PIN_0,1);
		HAL_Delay(1000);
		HAL_GPIO_WritePin(GPIOB,GPIO_PIN_1,0);
		HAL_GPIO_WritePin(GPIOB,GPIO_PIN_0,0);
		HAL_Delay(1000);
		HAL_GPIO_WritePin(GPIOB,GPIO_PIN_1,1);
		HAL_GPIO_WritePin(GPIOB,GPIO_PIN_0,1);

		//
	}

/* USER CODE END PFP */

/* USER CODE BEGIN 0 */
	int ProcessData()
	{
		uint8_t tmp[20];
	 if(DataRX[0] == 0x01)
	 {
		 InputSpeed =(int16_t)(((DataRX[1]<<8) + DataRX[2])-10000);
		 sprintf(tmp,"SSC: Speed %d \r\n",InputSpeed);
		 //TODO : Remove next line after tests
		 print(tmp);
	 }
	 return 0;
	}
/* USER CODE END 0 */

int main(void)
{

  /* USER CODE BEGIN 1 */
  /* USER CODE END 1 */

  /* MCU Configuration----------------------------------------------------------*/

  /* Reset of all peripherals, Initializes the Flash interface and the Systick. */
  HAL_Init();

  /* Configure the system clock */
  SystemClock_Config();

  /* Initialize all configured peripherals */
  MX_GPIO_Init();
  MX_DMA_Init();
  MX_ADC1_Init();
  MX_SPI1_Init();
  MX_TIM1_Init();
  MX_TIM2_Init();
  MX_TIM3_Init();
  MX_TIM4_Init();
  MX_USART1_UART_Init();

  /* USER CODE BEGIN 2 */
  HAL_GPIO_WritePin(GPIOB,GPIO_PIN_0,GPIO_PIN_SET);
  HAL_GPIO_WritePin(GPIOB,GPIO_PIN_1,GPIO_PIN_SET);
  HAL_SPI_Receive_DMA(&hspi1,(uint8_t *)&SpiRXData,1);
  print("Driver Module Started.")
  	  ZERO_INIT();
  /* USER CODE END 2 */

  /* Infinite loop */
  /* USER CODE BEGIN WHILE */
  while (1)
  {
  /* USER CODE END WHILE */

  /* USER CODE BEGIN 3 */
  }
  /* USER CODE END 3 */

}

/** System Clock Configuration
*/
void SystemClock_Config(void)
{

  RCC_OscInitTypeDef RCC_OscInitStruct;
  RCC_ClkInitTypeDef RCC_ClkInitStruct;
  RCC_PeriphCLKInitTypeDef PeriphClkInit;

  RCC_OscInitStruct.OscillatorType = RCC_OSCILLATORTYPE_HSE;
  RCC_OscInitStruct.HSEState = RCC_HSE_ON;
  RCC_OscInitStruct.HSEPredivValue = RCC_HSE_PREDIV_DIV1;
  RCC_OscInitStruct.PLL.PLLState = RCC_PLL_ON;
  RCC_OscInitStruct.PLL.PLLSource = RCC_PLLSOURCE_HSE;
  RCC_OscInitStruct.PLL.PLLMUL = RCC_PLL_MUL6;
  HAL_RCC_OscConfig(&RCC_OscInitStruct);

  RCC_ClkInitStruct.ClockType = RCC_CLOCKTYPE_HCLK|RCC_CLOCKTYPE_SYSCLK
                              |RCC_CLOCKTYPE_PCLK1|RCC_CLOCKTYPE_PCLK2;
  RCC_ClkInitStruct.SYSCLKSource = RCC_SYSCLKSOURCE_PLLCLK;
  RCC_ClkInitStruct.AHBCLKDivider = RCC_SYSCLK_DIV1;
  RCC_ClkInitStruct.APB1CLKDivider = RCC_HCLK_DIV2;
  RCC_ClkInitStruct.APB2CLKDivider = RCC_HCLK_DIV1;
  HAL_RCC_ClockConfig(&RCC_ClkInitStruct, FLASH_LATENCY_2);

  PeriphClkInit.PeriphClockSelection = RCC_PERIPHCLK_ADC;
  PeriphClkInit.AdcClockSelection = RCC_ADCPCLK2_DIV6;
  HAL_RCCEx_PeriphCLKConfig(&PeriphClkInit);

  HAL_SYSTICK_Config(HAL_RCC_GetHCLKFreq()/1000);

  HAL_SYSTICK_CLKSourceConfig(SYSTICK_CLKSOURCE_HCLK);

  /* SysTick_IRQn interrupt configuration */
  HAL_NVIC_SetPriority(SysTick_IRQn, 0, 0);
}

/* USER CODE BEGIN 4 */
//{HJ}
void HAL_SPI_RxCpltCallback(SPI_HandleTypeDef *hspi){

	//DataLostCount++;
//	NewDataFlag = 1;
//	uint8_t temp[40];
//	sprintf(temp,"SDR:%#x\r\n",SpiRXData);
//
	//HAL_SPI_DMAPause(hspi);
	if(LastSpiData == 0xFF && SpiRXData == 0xFF)
	{
		//sprintf(temp,"Start Sequence Detected\r\n");
		SpiSeq=1; // Start Sequence Found
		NewDataFlag = 0;
	}
	else if( SpiSeq == 1 && LastSpiData == 0xFF)
	{
		if(SpiRXData == MyAddress)
		{
			SpiSeq = 2;
			//sprintf(temp,"Address Was OK\r\n");
		}
	}
	else if(SpiSeq == 2) //Length RX Sequence
	{
	  	   SpiSeq = 3;
	  	   DataToRecieveLength = SpiRXData;
	  	   //sprintf(temp,"Length Set to %d\r\n",SpiRXData);
	}
	else if(SpiSeq >= 3 && (SpiSeq-3 < DataToRecieveLength)) //Data Receiving
	{
		DataRX[SpiSeq-3] = SpiRXData;
		SpiSeq++;
		//sprintf(temp,"Receive %d number of data\r\n",SpiSeq-3);
	}
	else if(SpiSeq-3 == DataToRecieveLength)
	{
		uint8_t CheckSum = 0;
		//sprintf(temp,"End Sequence Detected\r\n");
		CheckSum = (uint8_t)((DataToRecieveLength + DataRX[0] + DataRX[1] + DataRX[2])&(0b11111111));
		if(CheckSum == SpiRXData)
		{
			CommandRecieveCount++;
			NewDataFlag = 1;
		}
    	else if (CheckSum != SpiRXData){
    		DataLostCount++;
    	}
		SpiSeq = 0;
	}
	//HAL_SPI_DMAResume(hspi);
	LastSpiData = SpiRXData;

}
//{HJ}
void HAL_SPI_ErrorCallback(SPI_HandleTypeDef *hspi)
{
	uint8_t temperr = 0;
	temperr = HAL_SPI_GetError(hspi);
	if (temperr == HAL_SPI_ERROR_NONE) {
		print("NoError\r\n");
	} else if (temperr == HAL_SPI_ERROR_MODF) {
		print("HAL_SPI_ERROR_MODF\r\n");
	} else if (temperr == HAL_SPI_ERROR_OVR) {
		print("HAL_SPI_ERROR_OVR\r\n");
	} else if (temperr == HAL_SPI_ERROR_OVR) {
		print("HAL_SPI_ERROR_DMA\r\n");
	} else if (temperr == HAL_SPI_ERROR_OVR) {
		print("HAL_SPI_ERROR_FLAG\r\n");
	}

	hspi->ErrorCode =  HAL_SPI_ERROR_NONE;
	HAL_SPI_Receive_DMA(&hspi1,(uint8_t *)&SpiRXData,1);
}
/* USER CODE END 4 */

#ifdef USE_FULL_ASSERT

/**
   * @brief Reports the name of the source file and the source line number
   * where the assert_param error has occurred.
   * @param file: pointer to the source file name
   * @param line: assert_param error line source number
   * @retval None
   */
void assert_failed(uint8_t* file, uint32_t line)
{
  /* USER CODE BEGIN 6 */
  /* User can add his own implementation to report the file name and line number,
    ex: printf("Wrong parameters value: file %s on line %d\r\n", file, line) */
  /* USER CODE END 6 */

}

#endif

/**
  * @}
  */ 

/**
  * @}
*/ 

/************************ (C) COPYRIGHT STMicroelectronics *****END OF FILE****/
